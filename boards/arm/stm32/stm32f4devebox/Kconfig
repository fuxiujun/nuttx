## boards/arm/stm32/stm32f4devebox/Kconfig
```kconfig
#
# For a description of the syntax of this configuration file,
# see the file kconfig-language.txt in the NuttX tools repository.
#

if ARCH_BOARD_STM32F4_DEVEBOX

config STM32F4DISBB
	bool "STM32F4DIS-BB base board"
	default n
	
endif
```
